#include <stdio.h>
#include "stm32f4xx.h"
#include "fpu.h"
#include "uart.h"
#include "timebase.h"
#include "bsp.h"
#include "adc.h"
#include "cmox_crypto.h"
#include <string.h>




#define  GPIOAEN		(1U<<0)
#define  PIN5			(1U<<5)
#define  LED_PIN		PIN5


/* RSA context */
cmox_rsa_handle_t rsa_ctx;

/* RSA key */
cmox_rsa_key_t rsa_key;

/* RSA working buffer */
uint8_t working_buffer[7000];



const uint8_t seed[] =
{
  0x5c, 0xac, 0xa6, 0xa0, 0xf7, 0x64, 0x16, 0x1a, 0x96, 0x84, 0xf8, 0x5d, 0x92, 0xb6, 0xe0, 0xef,
  0x37, 0xca, 0x8b, 0x65
};

const uint8_t message[] =
{
  0xbc, 0xdd, 0x19, 0x0d, 0xa3, 0xb7, 0xd3, 0x00, 0xdf, 0x9a, 0x06, 0xe2, 0x2c, 0xaa, 0xe2, 0xa7,
  0x5f, 0x10, 0xc9, 0x1f, 0xf6, 0x67, 0xb7, 0xc1, 0x6b, 0xde, 0x8b, 0x53, 0x06, 0x4a, 0x26, 0x49,
  0xa9, 0x40, 0x45, 0xc9
};

const uint8_t expected_encrypted_text[] =
{
  0x63, 0x18, 0xe9, 0xfb, 0x5c, 0x0d, 0x05, 0xe5, 0x30, 0x7e, 0x16, 0x83, 0x43, 0x6e, 0x90, 0x32,
  0x93, 0xac, 0x46, 0x42, 0x35, 0x8a, 0xaa, 0x22, 0x3d, 0x71, 0x63, 0x01, 0x3a, 0xba, 0x87, 0xe2,
  0xdf, 0xda, 0x8e, 0x60, 0xc6, 0x86, 0x0e, 0x29, 0xa1, 0xe9, 0x26, 0x86, 0x16, 0x3e, 0xa0, 0xb9,
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  0x09, 0x39, 0xe9, 0x6a, 0x3c, 0x45, 0x0d, 0x2a, 0x8d, 0x5e, 0xee, 0x9f, 0x67, 0x80, 0x93, 0xc8
};

const uint8_t modulus[] =
{
  0xae, 0x45, 0xed, 0x56, 0x01, 0xce, 0xc6, 0xb8, 0xcc, 0x05, 0xf8, 0x03, 0x93, 0x5c, 0x67, 0x4d,
  0xdb, 0xe0, 0xd7, 0x5c, 0x4c, 0x09, 0xfd, 0x79, 0x51, 0xfc, 0x6b, 0x0c, 0xae, 0xc3, 0x13, 0xa8,
  0xdf, 0x39, 0x97, 0x0c, 0x51, 0x8b, 0xff, 0xba, 0x5e, 0xd6, 0x8f, 0x3f, 0x0d, 0x7f, 0x22, 0xa4,
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  0x36, 0xf8, 0x79, 0xd8, 0xa3, 0xac, 0x9d, 0x7d, 0x59, 0x86, 0x0e, 0xaa, 0xda, 0x6b, 0x83, 0xbb
};

const uint8_t public_exponent[] =
{
  0x01, 0x00, 0x01
};

const uint8_t private_exponent[] =
{
  0x05, 0x6b, 0x04, 0x21, 0x6f, 0xe5, 0xf3, 0x54, 0xac, 0x77, 0x25, 0x0a, 0x4b, 0x6b, 0x0c, 0x85,
  0x25, 0xa8, 0x5c, 0x59, 0xb0, 0xbd, 0x80, 0xc5, 0x64, 0x50, 0xa2, 0x2d, 0x5f, 0x43, 0x8e, 0x59,
  0x6a, 0x33, 0x3a, 0xa8, 0x75, 0xe2, 0x91, 0xdd, 0x43, 0xf4, 0x8c, 0xb8, 0x8b, 0x9d, 0x5f, 0xc0,
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  0x97, 0x07, 0x50, 0x36, 0xe9, 0x89, 0xf6, 0x09, 0x32, 0x80, 0x7b, 0x52, 0x57, 0x75, 0x1e, 0x79
};
void handle_error(const char *message) {

    // Print the error message to the debug console
    printf("ERROR: %s\n\r", message);

    while (1) {
        // Toggle an LED to indicate an error (assuming LED_PIN is configured)
        GPIOA->ODR ^= LED_PIN;  // Toggle LED
        for (volatile int i = 0; i < 1000000; i++);  // Delay loop
    }

}



/* Computed data buffer */
uint8_t computed_encryption[sizeof(expected_encrypted_text)];
uint8_t computed_text[sizeof(message)];

int main()
{

	cmox_cipher_retval_t  retval;
	size_t computed_size;

	/*Enable FPU*/
	fpu_enable();

	/*Initialize debug UART*/
	debug_uart_init();

	/*Initialize timebase*/
	timebase_init();

	/*Initialize LED*/
	led_init();

	/*Initialize Push button*/
	button_init();

	/*Initialize ADC*/
	pa1_adc_init();

	/*Start conversion*/
	start_conversion();

	/*Initialize cryptolib*/
	if(cmox_initialize(NULL) !=  CMOX_INIT_SUCCESS)
	{

     handle_error("ERROR: Init failed\r\n");


	}


	cmox_rsa_construct(&rsa_ctx, CMOX_RSA_MATH_FUNCS, CMOX_MODEXP_PUBLIC, working_buffer, sizeof(working_buffer));

    /* Fill in RSA key structure using the public key representation */
	retval = cmox_rsa_setKey(&rsa_key,                                      /* RSA key structure to fill */
	                           modulus, sizeof(modulus),                      /* public key modulus */
							   public_exponent, sizeof(public_exponent));   /* public key exponent */

	/* Verify API returned value */
	   if (retval != CMOX_RSA_SUCCESS)
	   {
			  handle_error("RSA key set failed!");

	   }


	   /* Compute directly the encrypted message passing all the needed parameters */
	   retval = cmox_rsa_pkcs1v22_encrypt(&rsa_ctx,                                 /* RSA context */
	                                      &rsa_key,                                 /* RSA key to use */
	                                      message, sizeof(message),                 /* Message to encrypt */
	                                      CMOX_RSA_PKCS1V22_HASH_SHA1,              /* Hash method to use */
	                                      seed, sizeof(seed),                       /* Random seed */
	                                      NULL, 0,                                  /* No label */
	                                      computed_encryption, &computed_size);  /* Data buffer to receive encrypted text */



	   /* Verify API returned value */
	   if (retval != CMOX_RSA_SUCCESS)
	   {
			 handle_error("RSA encryption failed!");

	   }


	   /* Verify generated data are the expected ones */
	   if (memcmp(computed_encryption, expected_encrypted_text, computed_size) != 0)
	   {
			 handle_error("RSA encryption content mismatch!");

	   }


	   /* Cleanup context */
	   cmox_rsa_cleanup(&rsa_ctx);
	while(1)
	{

	}
}

